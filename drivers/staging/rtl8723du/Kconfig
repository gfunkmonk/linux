## drivers/staging/rtl8723du/Kconfig
```kconfig
config RTL8723DU
        tristate "Realtek 8723DU USB WiFi"
        depends on USB && WLAN && CFG80211
        help
          Select this option will enable support for 8723DU chipset
          802.11n USB wireless network adapter.
```
